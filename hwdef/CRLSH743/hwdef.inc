define HAL_CHIBIOS_ARCH_CUBE 1

# USB setup
USB_STRING_MANUFACTURER "CRLS"
USB_STRING_PRODUCT "H743"

# crystal frequency
OSCILLATOR_HZ 24000000

# board ID. See Tools/AP_Bootloader/board_types.txt
APJ_BOARD_ID AP_HW_CRLSH743

# ChibiOS system timer
STM32_ST_USE_TIMER 2

# flash size
FLASH_SIZE_KB 2048
FLASH_RESERVE_START_KB 128
define HAL_STORAGE_SIZE 32768



# order of I2C buses
I2C_ORDER I2C1 I2C2

PB6 I2C1_SCL I2C1
PB7 I2C1_SDA I2C1
PB10 I2C2_SCL I2C2
PB11 I2C2_SDA I2C2

# baro
BARO ICP201XX I2C:0:0x63

# no built-in compass, but probe the i2c bus for all possible
# external compass types
define ALLOW_ARM_NO_COMPASS
define HAL_PROBE_EXTERNAL_I2C_COMPASSES
define HAL_I2C_INTERNAL_MASK 1
define HAL_COMPASS_AUTO_ROT_DEFAULT 2



# SWD
PA13 JTMS-SWDIO SWD
PA14 JTCK-SWCLK SWD



# SPI2 -> IMU1 (ICM45686)
PC2  SPI2_MISO SPI2
PC1  SPI2_MOSI SPI2
PD3  SPI2_SCK  SPI2
PC15 SP2_CS    CS
PC0  SP2_DRDY  INPUT

# SPI3 -> IMU2 (ICM45686)
PC11 SPI3_MISO SPI3
PC12 SPI3_MOSI SPI3
PC10 SPI3_SCK  SPI3
PA15 SP3_CS    CS
PD2  SP3_DRDY  INPUT

# SPI4 -> IMU3 (ICM45686)
PE13 SPI4_MISO SPI4
PE6  SPI4_MOSI SPI4
PE12 SPI4_SCK  SPI4
PA5  SP4_CS    CS
PC5  SP4_DRDY  INPUT

# IMU assignments
SPIDEV imu1 SPI2 DEVID1 SP2_CS  MODE3  2*MHZ 12*MHZ
SPIDEV imu2 SPI3 DEVID1 SP3_CS  MODE3  2*MHZ 12*MHZ
SPIDEV imu3 SPI4 DEVID1 SP4_CS  MODE3  2*MHZ 12*MHZ
IMU Invensensev3 SPI:imu1 ROTATION_YAW_180
IMU Invensensev3 SPI:imu2 ROTATION_YAW_270
IMU Invensensev3 SPI:imu3 ROTATION_YAW_90
# define HAL_DEFAULT_INS_FAST_SAMPLE 1



# sensing
PA1 BATT_VOLTAGE_SENS ADC1 SCALE(1)
define HAL_BATT_MONITOR_DEFAULT 3 # only voltage
define HAL_BATT_VOLT_PIN 10
define HAL_BATT_CURR_PIN -1
define HAL_BATT_VOLT_SCALE 31.303030303
define HAL_BATT_CURR_SCALE 0



# order of UARTs (and USB)
SERIAL_ORDER OTG1 EMPTY USART2 USART3 UART4 EMPTY EMPTY UART7 UART8

# USB
PA11 OTG_FS_DM OTG1
PA12 OTG_FS_DP OTG1

# pinouts from CubeMX
PD0  UART4_RX  UART4
PD1  UART4_TX  UART4
PE7  UART7_RX  UART7
PE8  UART7_TX  UART7
PE9  UART7_RTS UART7
PE10 UART7_CTS UART7
PE0  UART8_RX  UART8
PE1  UART8_TX  UART8
PA3  USART2_RX USART2
PA2  USART2_TX USART2
PD9  USART3_RX USART3
PD8  USART3_TX USART3



# CAN
PB8 CAN1_RX CAN1
PB9 CAN1_TX CAN1
PB12 CAN2_RX CAN2
PB13 CAN2_TX CAN2



# Motors (TIM1, TIM4, TIM8)
PA7  TIM3_CH2 TIM3 PWM(1)  GPIO(50)
PA6  TIM3_CH1 TIM3 PWM(2)  GPIO(51)
PB1  TIM3_CH4 TIM3 PWM(3)  GPIO(52)
PB0  TIM3_CH3 TIM3 PWM(4)  GPIO(53)

PD12 TIM4_CH1 TIM4 PWM(5)  GPIO(54)
PD13 TIM4_CH2 TIM4 PWM(6)  GPIO(55)
PD14 TIM4_CH3 TIM4 PWM(7)  GPIO(56)
PD15 TIM4_CH4 TIM4 PWM(8)  GPIO(57)

PC8  TIM8_CH3 TIM8 PWM(9)  GPIO(58) BIDIR
PC6  TIM8_CH1 TIM8 PWM(10) GPIO(59) BIDIR
PC9  TIM8_CH4 TIM8 PWM(11) GPIO(60) BIDIR
PC7  TIM8_CH2 TIM8 PWM(12) GPIO(61) BIDIR

PE14 TIM1_CH4 TIM1 PWM(13) GPIO(62) BIDIR
PA8  TIM1_CH1 TIM1 PWM(14) GPIO(63) BIDIR
PA10 TIM1_CH3 TIM1 PWM(15) GPIO(64) BIDIR
PA9  TIM1_CH2 TIM1 PWM(16) GPIO(65) BIDIR

# RGB LED
PE5 TIM15_CH1 TIM15 PWM(17) GPIO(66)
# setup in defaults.parm



# microSD support
PD6  SDMMC2_CK  SDMMC2
PD7  SDMMC2_CMD SDMMC2
PB14 SDMMC2_D0  SDMMC2
PB15 SDMMC2_D1  SDMMC2
PB3  SDMMC2_D2  SDMMC2
PB4  SDMMC2_D3  SDMMC2

define FATFS_HAL_DEVICE SDCD2
define AP_BOOTLOADER_FLASH_FROM_SD_ENABLED 1
define AP_FILESYSTEM_FATFS 1
define HAL_OS_FATFS_IO 1



DMA_NOSHARE SPI3* I2C1*
# DMA_PRIORITY SDMMC* UART4* SPI* TIM*

# enable DFU by default
ENABLE_DFU_BOOT 1
