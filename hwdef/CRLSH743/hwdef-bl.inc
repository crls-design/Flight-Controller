# USB setup
USB_STRING_MANUFACTURER "CRLS"
USB_STRING_PRODUCT "H743"

# crystal frequency, setup to use external oscillator
OSCILLATOR_HZ 24000000

# board ID. See Tools/AP_Bootloader/board_types.txt
APJ_BOARD_ID AP_HW_CRLSH743

# flash size
FLASH_SIZE_KB 2048
FLASH_RESERVE_START_KB 0
FLASH_BOOTLOADER_LOAD_KB 128



# RGB LED
PE5 TIM15_CH1 TIM15 PWM(17) GPIO(66)
# setup in defaults.parm



# SWD
PA13 JTMS-SWDIO SWD
PA14 JTCK-SWCLK SWD



# order of UARTs (and USB)
SERIAL_ORDER OTG1

# OTG1
PA11 OTG_FS_DM OTG1
PA12 OTG_FS_DP OTG1

# Add CS pins to ensure they are high in bootloader
PC15 SP2_CS CS
PA15 SP3_CS CS
PA5  SP4_CS CS

# microSD support
PD6  SDMMC2_CK  SDMMC2
PD7  SDMMC2_CMD SDMMC2
PB14 SDMMC2_D0  SDMMC2
PB15 SDMMC2_D1  SDMMC2
PB3  SDMMC2_D2  SDMMC2
PB4  SDMMC2_D3  SDMMC2

define FATFS_HAL_DEVICE SDCD2
define AP_BOOTLOADER_FLASH_FROM_SD_ENABLED 1
define AP_FILESYSTEM_FATFS 1
define HAL_OS_FATFS_IO 1

define CH_CFG_USE_MEMCORE 1
define CH_CFG_USE_HEAP 1
define CH_CFG_USE_SEMAPHORES 0
define CH_CFG_USE_MUTEXES 1
define CH_CFG_USE_DYNAMIC 1
define CH_CFG_USE_WAITEXIT 1
define CH_CFG_USE_REGISTRY 1



# enable DFU by default
ENABLE_DFU_BOOT 1
